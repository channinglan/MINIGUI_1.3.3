## configs/config.in
```kconfig
#
# For a description of the syntax of this configuration file,
# see _LINUX_SOURCE_DIR/Documentation/kbuild/config-language.txt.
#

mainmenu_name "MiniGUI Value-added Release Configuration"

# system wide options
mainmenu_option next_comment
comment 'System wide options'

bool 'Build MiniGUI-Lite' CONFIG_LITE
if [ "$CONFIG_LITE" = "y" ]; then
    bool '  Stand-Alone' CONFIG_STAND_ALONE
fi
bool 'Use incore (built-in) resource' CONFIG_INCORE_RES
bool 'Unit of timer is 10ms' CONFIG_TIMERUNIT10MS
bool 'Cursor support' CONFIG_CURSORSUPPORT

bool 'User can move window with mouse' CONFIG_MOVEABLE
bool 'Mouse button can do double click' CONFIG_DBCLK
bool 'Build with debugging messages' CONFIG_DEBUG
bool 'Trace messages of MiniGUI' CONFIG_TRACEMESSAGE
bool 'Include symbol name of messages' CONFIG_MSGSTR

endmenu

# GAL engine options
mainmenu_option next_comment
comment 'GAL engine options'

choice 'GAL and its engines' \
    "NEWGAL                    CONFIG_NEWGAL     \
     OLDGAL                    CONFIG_OLDGAL"    NEWGAL

if [ "$CONFIG_OLDGAL" = "y" ]; then
    bool '  Native FrameBuffer graphics GAL engine' CONFIG_GAL_NATIVE
    if [ "$CONFIG_GAL_NATIVE" = "y" ]; then

        bool '    Native GAL engine on Linux FrameBuffer console' CONFIG_GAL_NATIVE_FBCON
        bool '    Native GAL engine on Qt Virtual FrameBuffer' CONFIG_GAL_NATIVE_QVFB
        bool '    Native GAL engine on eCos LCD interface' CONFIG_GAL_NATIVE_ECOSLCD

        choice 'Support for rotation of screen' \
        "Clockwise-90                       CONFIG_GAL_NATIVE_COORTRANS_CW        \
         Counter-clockwise-90               CONFIG_GAL_NATIVE_COORTRANS_CCW       \
         none                               CONFIG_GAL_NATIVE_COORTRANS_NONE"     none

        comment '    Native GAL Subdrivers'
        bool '    1BPP FB (MSB is right)' CONFIG_GAL_NATIVE_R1BPPFB
        bool '    1BPP FB (MSB is left)' CONFIG_GAL_NATIVE_L1BPPFB
        bool '    2BPP FB (MSB is right)' CONFIG_GAL_NATIVE_R2BPPFB
        bool '    2BPP FB (MSB is left)' CONFIG_GAL_NATIVE_L2BPPFB
        bool '    4BPP FB (MSB is right)' CONFIG_GAL_NATIVE_R4BPPFB
        bool '    4BPP FB (MSB is left)' CONFIG_GAL_NATIVE_L4BPPFB
        bool '    8BPP FB' CONFIG_GAL_NATIVE_8BPPFB
        bool '    16BPP FB' CONFIG_GAL_NATIVE_16BPPFB
        bool '    24BPP FB (incompleted)' CONFIG_GAL_NATIVE_24BPPFB
        bool '    32BPP FB' CONFIG_GAL_NATIVE_32BPPFB
        bool '    VGA16 FB (do not include, dangerous)' CONFIG_GAL_NATIVE_VGA16FB
    fi


    if [ "$CONFIG_LITE" != "y" ]; then
        bool '  GAL and IAL engine on SVGALIB (for old GAL and MiniGUI-Thread)' CONFIG_GALIAL_SVGALIB
        bool '  GAL and IAL engine on LibGGI (for old GAL and MiniGUI-Thread)' CONIFG_GALIAL_LIBGGI
    fi

    bool '  VGA 16-color mode' CONFIG_GAL_VGA16

else

    bool '  NEWGAL engine on Linux FrameBuffer console' CONFIG_NEWGAL_FBCON
    bool '  NEWGAL engine on Qt Virtual FrameBuffer' CONFIG_NEWGAL_QVFB
    bool '  NEWGAL engine on eCos LCD interface' CONFIG_NEWGAL_ECOSLCD
    bool '  Dummy NEWGAL engine' CONFIG_NEWGAL_DUMMY

fi

bool 'Have console on Linux FrameBuffer' CONFIG_GAL_NATIVE_TEXTMODE

endmenu

# IAL engine options
mainmenu_option next_comment
comment 'IAL engine options'

bool 'EP7211-based board' CONFIG_IAL_EP7211
bool 'ADS Graphics Client' CONFIG_IAL_ADS
bool 'iPAQ H3600 (also H3800)' CONFIG_IAL_IPAQ
bool 'MPC823' CONFIG_IAL_MPC823
bool 'PX255B' 	CONFIG_IAL_PX255B
bool 'NEC VR4181' CONFIG_IAL_VR4181
bool 'Helio Touch Panel' CONFIG_IAL_HELIO
bool 'MT T800' CONFIG_IAL_MTT800
bool 'SMDK2410 Touch Screen' CONFIG_IAL_SMDK2410
bool 'uClinux Touch Screen Palm/MC68EZ328' CONFIG_IAL_MC68X328
bool 'Dummy IAL engine' CONFIG_IAL_DUMMY

bool 'Native (console) input engine' CONFIG_IAL_NATIVE
if [ "$CONFIG_IAL_NATIVE" = "y" ]; then
    comment '  Native IAL engine subdriver options'
    bool '  PS2 mouse' CONFIG_IAL_NATIVE_PS2MOUSE
    bool '  IntelligentMouse (IMPS/2) mouse' CONFIG_IAL_NATIVE_IMPS2MOUSE
    bool '  MS mouse' CONFIG_IAL_NATIVE_MSMOUSE
    bool '  MS3 mouse' CONFIG_IAL_NATIVE_MS3MOUSE
    bool '  GPM daemon' CONFIG_IAL_NATIVE_GPM
fi

endmenu

# Font options
mainmenu_option next_comment
comment 'Font options'

bool 'Raw bitmap font' CONFIG_FONT_RBF
if [ "$CONFIG_INCORE_RES" = "y" ]; then
    bool '  Incore GB2312 12x12 RBF font' CONFIG_FONT_INCOREGB12
fi
bool 'Var bitmap font' CONFIG_FONT_VBF
bool 'Incore font sansserif' CONFIG_FONT_INCORESSERIF
bool 'Incore font courier' CONFIG_FONT_INCORECOURIER
bool 'Incore font symbol' CONFIG_FONT_INCORESYMBOL
bool 'Incore font vgas' CONFIG_FONT_INCOREVGAS
bool 'Qt Prerendered Font' CONFIG_FONT_QPF
bool 'TrueType font' CONFIG_FONT_TTF
bool 'Adobe Type1 font' CONFIG_FONT_TYPE1

endmenu

# Charset options
mainmenu_option next_comment
comment 'Charset options'

bool 'East European (Latin 2, ISO-8859-2) charset' CONFIG_CHARSET_LATIN2
bool 'South European (Latin 3, ISO-8859-3) charset' CONFIG_CHARSET_LATIN3
bool 'North European (Latin 4, ISO-8859-4) charset' CONFIG_CHARSET_LATIN4
bool 'Cyrillic (ISO-8859-5) charset' CONFIG_CHARSET_CYRILLIC
bool 'Arabic (ISO-8859-6) charset' CONFIG_CHARSET_ARABIC
bool 'Greek (ISO-8859-7) charset' CONFIG_CHARSET_GREEK
bool 'Hebrew (ISO-8859-8) charset' CONFIG_CHARSET_HEBREW
bool 'Turkish (Latin 5, ISO-8859-9) charset' CONFIG_CHARSET_LATIN5
bool 'Nordic, Latin 6, ISO-8859-10) charset' CONFIG_CHARSET_LATIN6
bool 'Thai (ISO-8859-11) charset' CONFIG_CHARSET_THAI
bool 'Latin 7 (ISO-8859-13) charset' CONFIG_CHARSET_LATIN7
bool 'Latin 8 (ISO-8859-14) charset' CONFIG_CHARSET_LATIN8
bool 'Latin 9 (ISO-8859-15, West Extended) charset' CONFIG_CHARSET_LATIN9
bool 'Latin 10 (ISO-8859-16, Romanian) charset' CONFIG_CHARSET_LATIN10
bool 'EUC encoding of GB2312 charset' CONFIG_CHARSET_GB2312
bool 'GBK charset' CONFIG_CHARSET_GBK
bool 'GB18030-0 charset' CONFIG_CHARSET_GB18030
bool 'BIG5 charset' CONFIG_CHARSET_BIG5
bool 'EUC encoding of KSC5636 and KSC5601 charsets' CONFIG_CHARSET_EUCKR
bool 'EUC encoding of JISX0201 and JISX0208 charsets' CONFIG_CHARSET_EUCJP
bool 'Shift-JIS encoding of JISX0201 and JISX0208 charsets' CONFIG_CHARSET_SHIFTJIS
bool 'UNICODE (ISO-10646-1 and UTF-8 encoding)' CONFIG_CHARSET_UNICODE

endmenu

# Keyboard layout specific options
mainmenu_option next_comment
comment 'Keyboard layout specific options'

bool 'French PC keyboard (non-US 102 keys)' CONFIG_KBD_FRPC
bool 'Keyboard layout for French' CONFIG_KBD_FR
bool 'Keyboard layout for German' CONFIG_KBD_DE
bool 'Keyboard layout for German Latin1' CONFIG_KBD_DELATIN1
bool 'Keyboard layout for Italian' CONFIG_KBD_IT
bool 'Keyboard layout for Spanish' CONFIG_KBD_ES
bool 'Keyboard layout for Spanish CP850' CONFIG_KBD_ESCP850

endmenu

# Image options
mainmenu_option next_comment
comment 'Image options'

bool 'Includes SaveBitmap-related functions' CONFIG_IMAGE_SAVEBMP
bool 'PCX file support' CONFIG_IMAGE_PCX
bool 'LBM/PBM file support' CONFIG_IMAGE_LBM
bool 'TGA file support' CONFIG_IMAGE_TGA
bool 'GIF file support' CONFIG_IMAGE_GIF
bool 'JPG file support' CONFIG_IMAGE_JPG
bool 'PNG file support' CONFIG_IMAGE_PNG

endmenu

# Input method options
mainmenu_option next_comment
comment 'Input method options'

bool 'IME (GB2312) support' CONFIG_IME_GB2312
bool 'IME (GB2312) Intelligent Pinyin module' CONFIG_IME_GB2312PINYIN

endmenu

# Appearance options
mainmenu_option next_comment
comment 'Appearance options'

bool 'Using flat window style instead of 3D style' CONFIG_APPEARANCE_FLATSTYLE
if [ "$CONFIG_APPEARANCE_FLATSTYLE" = "y" ]; then
    bool '  Target is a gray screen' CONFIG_APPEARANCE_GRAYSCR
fi
bool 'Target is a tiny-size screen' CONFIG_APPEARANCE_TINYSCR

endmenu

# Misc options
mainmenu_option next_comment
comment 'Misc options'

bool 'Include About Dialog Box' CONFIG_MISC_ABOUTDLG
bool 'Include code for screenshots' CONFIG_MISC_SAVESCR

endmenu

# Controls options
mainmenu_option next_comment
comment 'Controls options'

bool 'Static' CONFIG_CTRL_STATIC
bool 'Button' CONFIG_CTRL_BUTTON
bool 'Simple Edit' CONFIG_CTRL_SIMEDIT
bool 'Single-Line Edit' CONFIG_CTRL_SLEDIT
bool 'Multi-Line Edit' CONFIG_CTRL_MLEDIT
bool 'ListBox' CONFIG_CTRL_LISTBOX
bool 'ProgressBar' CONFIG_CTRL_PROGRESSBAR
bool 'ToolBar' CONFIG_CTRL_TOOLBAR
bool 'NewToolBar' CONFIG_CTRL_NEWTOOLBAR
bool 'MenuButton' CONFIG_CTRL_MENUBUTTON
bool 'TrackBar' CONFIG_CTRL_TRACKBAR
bool 'ComboBox' CONFIG_CTRL_COMBOBOX
bool 'PropertySheet' CONFIG_CTRL_PROPSHEET

endmenu

# Ext library options
mainmenu_option next_comment
comment 'Ext library options'

bool 'TreeView control' CONFIG_EXT_TREEVIEW
bool 'ListView control' CONFIG_EXT_LISTVIEW
bool 'Grid control' CONFIG_EXT_GRID
bool 'MonthCalendar control' CONFIG_EXT_MONTHCAL
bool 'SpinBox control' CONFIG_EXT_SPINBOX
bool 'CoolBar control' CONFIG_EXT_COOLBAR
bool 'Full GIF98a support' CONFIG_EXT_FULLGIF
bool 'Skin support' CONFIG_EXT_SKIN

bool 'Library of VCOnGUI' CONFIG_LIBVCONGUI

endmenu

# -----------------------------------------------------------------------------

comment ''

# Development environment options
mainmenu_option next_comment
comment 'Development environment options'

# platform selection
choice 'Platform' \
        "Linux          CONFIG_PLATFORM_LINUX       \
         uClinux        CONFIG_PLATFORM_UCLINUX     \
         eCos           CONFIG_PLATFORM_ECOS" Linux \

# compiler selection
choice 'Compiler' \
        "arm-linux-gcc          CONFIG_COMPILER_ARM              \
         armv4l-unknown-linux-gcc       CONFIG_COMPILER_ARMV4L           \
         mipsel-linux-gcc       CONFIG_COMPILER_MIPSEL           \
         ppc-linux-gcc          CONFIG_COMPILER_PPC              \
         m68k-elf-gcc           CONFIG_COMPILER_M68K_ELF         \
         arm-elf-gcc            CONFIG_COMPILER_ARM_ELF          \
         i386                   CONFIG_COMPILER_X86"       i386

# target selection
if [ "$CONFIG_COMPILER_M68K_ELF" = "y" ]; then
choice 'Target' \
        "m68k/68328            CONFIG_TARGET_M68K_XCOPILOT    \
         m68k/68ez328          CONFIG_TARGET_M68K_68EZ328     \
         m68k/Coldfire5200     CONFIG_TARGET_M68K_CF5200      \
         m68k/Coldfire5307     CONFIG_TARGET_M68K_CF5307"     m68k/68328 
fi

if [ "$CONFIG_PLATFORM_ECOS" = "y" ]; then
choice 'Target' \
         "sa11x0/iPAQ           CONFIG_TARGET_SA11X0_IPAQ"     sa11x0/iPAQ 
fi

# libc selection
choice 'Libc' \
        "glibc          CONFIG_LIBC_GLIBC              \
         uClibc         CONFIG_LIBC_UCLIBC"       glibc

if [ "$CONFIG_COMPILER_X86" = "y" ]; then
    define_mystring TARGET_ARCH "i386"
    define_mystring TARGET "i386-linux"
    define_mystring HOST "i386-linux"
    define_mystring CC   "gcc"
    define_mystring DEF_PREFIX "/usr/local"
fi
if [ "$CONFIG_COMPILER_ARM" = "y" ]; then
    define_mystring TARGET_ARCH "arm"
    define_mystring TARGET "arm-linux"
    define_mystring HOST "arm-linux"
    define_mystring CC   "arm-linux-gcc"
    define_mystring DEF_PREFIX "/usr/local/arm-linux/arm-linux"
fi
if [ "$CONFIG_COMPILER_ARMV4L" = "y" ]; then
    define_mystring TARGET_ARCH "armv4l"
    define_mystring TARGET "arm-unknown-linux"
    define_mystring HOST "arm-unknown-linux"
    define_mystring CC   "armv4l-unknown-linux-gcc"
    define_mystring DEF_PREFIX "/opt/host/armv4l/armv4l-unknown-linux"
fi
if [ "$CONFIG_COMPILER_MIPSEL" = "y" ]; then
    define_mystring TARGET_ARCH "mipsel"
    define_mystring TARGET "mipsel-linux"
    define_mystring HOST "mipsel-linux"
    define_mystring CC   "mipsel-linux-gcc"
    define_mystring DEF_PREFIX "/usr/mipsel-linux"
fi
if [ "$CONFIG_COMPILER_PPC" = "y" ]; then
    define_mystring TARGET_ARCH "ppc"
    define_mystring TARGET "ppc-linux"
    define_mystring HOST "ppc-linux"
    define_mystring CC   "ppc-linux-gcc"
    define_mystring DEF_PREFIX "/usr/ppc-linux"
fi
if [ "$CONFIG_COMPILER_M68K_ELF" = "y" ]; then
    define_mystring TARGET_ARCH "m68k"
    define_mystring TARGET m68k-elf-linux
    define_mystring HOST m68k-elf-linux
    define_mystring CC   m68k-elf-gcc
    if [ "$CONFIG_PLATFORM_UCLINUX" = "y" ]; then
        define_mystring DEF_PREFIX "/opt/uClinux/m68k-elf"
    else
        define_mystring DEF_PREFIX "/usr/local/m68k-elf"
    fi
fi
if [ "$CONFIG_COMPILER_ARM_ELF" = "y" ]; then
    define_mystring TARGET_ARCH "arm"
    define_mystring TARGET "arm-elf-linux"
    define_mystring HOST "arm-elf-linux"
    define_mystring CC   "arm-elf-gcc"
    if [ "$CONFIG_PLATFORM_UCLINUX" = "y" ]; then
        define_mystring DEF_PREFIX "/opt/uClinux/arm-elf"
    else
        define_mystring DEF_PREFIX "/usr/local/arm-elf"
    fi
fi

# compilation options

# path selection
if [ "$CONFIG_PLATFORM_UCLINUX" = "y" ]; then
    comment 'Compilation and installation options'
    mystring 'uClinux dist directory' UCDIST_DIR /opt/uClinux/uClinux-dist
    define_mystring UC_KERNEL_HEADER "$UCDIST_DIR/linux-2.4.x/include"
    bool 'Choose different uClibc directory' CONFIG_UCLIBC_DIR
    if [ "$CONFIG_UCLIBC_DIR" = "y" ]; then
      mystring "uClibc header" UCLIBC_HEADER "$UCDIST_DIR/lib/uClibc/include"
      mystring "uClibc lib" UCLIBC_LIB "$UCDIST_DIR/lib/uClibc/lib"
    else
      define_mystring UCLIBC_HEADER "$UCDIST_DIR/lib/uClibc/include"
      define_mystring UCLIBC_LIB "$UCDIST_DIR/lib/uClibc/lib"
    fi
    if [ "$CONFIG_LIBC_UCLIBC" = "y" ]; then
       define_bool CONFIG_NO_SHARE y
    fi
else
  if [ "$CONFIG_LIBC_UCLIBC" = "y" ]; then
    comment 'Options for uClibc'
    mystring 'uClibc header' UCLIBC_HEADER $/usr/$TARGET_ARCH-linux-uclibc/include
    mystring 'uClibc lib' UCLIBC_LIB $/usr/$TARGET_ARCH-linux-uclibc/lib
  fi
fi

# must needed ?
#define_mystring_null PREFIX

comment 'Installation options'
mystring 'Path prefix' PREFIX $DEF_PREFIX

comment 'Additonal Compiler Flags'
mystring 'CFLAGS' ADD_CFLAGS
mystring 'LDFLAGS' ADD_LDFLAGS

endmenu

# end
```
